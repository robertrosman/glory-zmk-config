/*
 * Copyright (c) 2020 Pete Johanson
 *
 * SPDX-License-Identifier: MIT
 */

#include "glory.dtsi"
#include "trackball.dtsi"

&default_transform {
    col-offset = <6>;
};

/* The trackball lives on this (peripheral) half; forward it over split channel 0. */
&trackball_split {
    device = <&trackball>;
};

&kscan0 {
    col-gpios
        = <&pro_micro 3 GPIO_ACTIVE_HIGH>
        , <&pro_micro 4 GPIO_ACTIVE_HIGH>
        , <&pro_micro 5 GPIO_ACTIVE_HIGH>
        , <&pro_micro 6 GPIO_ACTIVE_HIGH>
        , <&pro_micro 7 GPIO_ACTIVE_HIGH>
        , <&pro_micro 8 GPIO_ACTIVE_HIGH>
        ;
};

// vim: filetype=dts fdm=marker:
